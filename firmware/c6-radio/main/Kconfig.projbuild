## firmware/c6-radio/main/Kconfig.projbuild
```kconfig
menu "Zigbee sniffer radio"

    config SNIFF_CHANNEL
        int "802.15.4 channel at boot"
        range 11 26
        default 25
        help
            The channel to listen on (Zigbee2MQTT's default is 11). The HA app can change it at runtime.

    choice SNIFF_LINK
        prompt "Link to the bridge or the app"
        default SNIFF_LINK_UART
        help
            UART: wired to an ESP32-S3 Wi-Fi bridge (the original pair).
            USB: the chip's own USB port, plugged straight into the Home Assistant box; the HA app
            reads it as a USB sniffer. The console log moves to UART0 so the USB carries frames only.

        config SNIFF_LINK_UART
            bool "UART to the Wi-Fi bridge"
        config SNIFF_LINK_USB
            bool "USB to the Home Assistant box"
            depends on SOC_USB_SERIAL_JTAG_SUPPORTED
    endchoice

    config SNIFF_UART_TX_GPIO
        int "UART TX GPIO (to the bridge's RX)"
        depends on SNIFF_LINK_UART
        default 16
        help
            XIAO ESP32C6 pad D6 = GPIO16.

    config SNIFF_UART_RX_GPIO
        int "UART RX GPIO (from the bridge's TX)"
        depends on SNIFF_LINK_UART
        default 17
        help
            XIAO ESP32C6 pad D7 = GPIO17.

    config SNIFF_UART_BAUD
        int "UART baud rate"
        depends on SNIFF_LINK_UART
        default 921600

    config SNIFF_XIAO_RF_SWITCH
        bool "Drive the XIAO ESP32C6 antenna switch"
        default y if IDF_TARGET_ESP32C6
        default n
        help
            The XIAO ESP32C5 has no antenna switch: its radio goes straight to the U.FL socket.

    config SNIFF_EXTERNAL_ANTENNA
        bool "Use the U.FL external antenna"
        depends on SNIFF_XIAO_RF_SWITCH
        default n

    config SNIFF_LED_GPIO
        int "Activity LED GPIO (-1 = none)"
        range -1 30
        default 15 if IDF_TARGET_ESP32C6
        default 27 if IDF_TARGET_ESP32C5
        default -1

endmenu
```

## firmware/s3-bridge/main/Kconfig.projbuild
```kconfig
menu "Zigbee sniffer bridge"

    config BRIDGE_WIFI_SSID
        string "Wi-Fi network name"
        default ""
        help
            Set in sdkconfig.secrets (git-ignored), not here.

    config BRIDGE_WIFI_PASSWORD
        string "Wi-Fi password"
        default ""
        help
            Set in sdkconfig.secrets (git-ignored), not here.

    config BRIDGE_UPDATE_TOKEN
        string "Firmware update token"
        default ""
        help
            Required in the X-Update-Token header of POST /update/bridge and /update/radio.
            Empty = updates over Wi-Fi are off. Set in sdkconfig.secrets (git-ignored), not here;
            tools/update.py reads it from there.

    config BRIDGE_TCP_PORT
        int "TCP port Home Assistant connects to"
        default 6638

    config BRIDGE_UART_TX_GPIO
        int "UART TX GPIO (to the radio's RX)"
        default 43
        help
            GPIO43: the pin labelled TX on the ESP32-S3 Super Mini and the DevKitC-1. On the DevKitC-1
            it is shared with the USB-to-UART chip: keep its UART port unplugged (or use 17/18).

    config BRIDGE_UART_RX_GPIO
        int "UART RX GPIO (from the radio's TX)"
        default 44
        help
            GPIO44: the pin labelled RX on the ESP32-S3 Super Mini and the DevKitC-1.

    config BRIDGE_UART_BAUD
        int "UART baud rate (must match the radio)"
        default 921600

    config BRIDGE_LED_GPIO
        int "Plain status LED GPIO, lit when low (-1 = none)"
        range -1 48
        default -1
        help
            Off by default: the ESP32-S3 Super Mini's LED is an RGB (WS2812) LED on GPIO48, which a
            plain GPIO can't drive (the DevKitC-1 has one too, on GPIO38 or 48).

endmenu
```
